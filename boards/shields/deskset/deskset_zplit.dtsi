/ {
    split_inputs {
        #address-cells = <1>;
        #size-cells = <0>;

        sidecar_split: sidecar@0 { compatible = "zmk,input-split"; reg = <0>; };
        corne_tpad_split: corne_tpad@1 { compatible = "zmk,input-split"; reg = <1>; };
    };
};
